## arch/cosmac/Kconfig
```kconfig
#
# For a description of the syntax of this configuration file,
# see the file kconfig-language.txt in the NuttX tools repository.
#

if ARCH_COSMAC
comment "COSMAC Options"

choice
	prompt "COSMAC chip selection"
	default ARCH_CHIP_CDP1802

config ARCH_CHIP_CDP1802
	bool "RCA CDP1802"
	select MM_SMALL
	select LIBC_ATOMIC_IRQ
	---help---
		RCA CDP1802 COSMAC 8-bit microprocessor (compiled with
		cdp1802-elf-gcc -march=1802).

endchoice # COSMAC chip selection

config ARCH_CHIP
	string
	default "cdp1802" if ARCH_CHIP_CDP1802

choice
	prompt "Interrupt enable state"
	default COSMAC_IRQSTATE_LSIE

config COSMAC_IRQSTATE_LSIE
	bool "Read IE with LSIE"
	---help---
		up_irq_save() reads the hardware IE flip-flop with the LSIE
		instruction (long skip if IE=1) and changes it with DIS/RET, like
		the other NuttX ports that read their hardware interrupt state.

config COSMAC_IRQSTATE_SWFLAG
	bool "Software interrupt-enable flag"
	---help---
		Keep a copy of IE in RAM (g_cosmac_ie) instead of reading it
		with LSIE.  up_irq_save/restore/enable and the interrupt entry and
		exit keep the copy equal to IE; changing IE still takes DIS/RET.

endchoice # Interrupt enable state

config COSMAC_BANKING
	bool
	default n
	---help---
		Code banking (selected by the board's memory profile): a 16 KiB
		window at 0x8000 shows one bank of a larger ROM, selected by a
		write-only latch on an output port.  Objects are placed in banks by
		tools/cosmac/cosmac_bank.py at link time; calls between regions go
		through stubs in fixed ROM and the far-call trampoline
		(arch/cosmac/src/common/cosmac_farcall.S).

if COSMAC_BANKING

config COSMAC_BANK_PORT
	int "Bank latch output port"
	default 1
	range 1 5
	---help---
		N of the OUT N instruction that writes the bank latch.  Ports 6 and
		7 belong to the sim1802 I/O controller.

config COSMAC_BANK_COUNT
	int "Number of 16 KiB banks"
	default 8
	range 1 256
	---help---
		Banks available to the placement tool.  The ROM image is the 32 KiB
		fixed part followed by this many banks.

config COSMAC_BRS_DEPTH
	int "Bank return stack depth"
	default 24
	range 1 255
	---help---
		Maximum nesting of far calls per thread (3 bytes of RAM each per
		thread).  Overflow causes a PANIC.  NSH's ps nests 18 far calls
		on sim1802; the depth needed also depends on code placement, so
		keep a margin.

endif # COSMAC_BANKING

endif # ARCH_COSMAC
```

## boards/cosmac/cdp1802/sim1802/Kconfig
```kconfig
#
# For a description of the syntax of this configuration file,
# see the file kconfig-language.txt in the NuttX tools repository.
#

if ARCH_BOARD_SIM1802

choice
	prompt "Memory profile"
	default BOARD_SIM1802_PROFILE_HW32

config BOARD_SIM1802_PROFILE_HW32
	bool "HW32/32: 32 KiB ROM at 0x0000, 32 KiB RAM at 0x8000"
	---help---
		The layout of a typical real COSMAC board.  The ROM image
		(nuttx.bin) must fit in 32 KiB.  Used for feasibility judgements.

config BOARD_SIM1802_PROFILE_HW48
	bool "HW48/16: 48 KiB ROM at 0x0000, 16 KiB RAM at 0xC000"
	---help---
		More ROM for less RAM: the ROM image (nuttx.bin) may be up to
		48 KiB.  The same address split is used by the banked profile
		(ROM window 0x8000-0xBFFF).

config BOARD_SIM1802_PROFILE_HWB
	bool "HWB: 32 KiB fixed ROM, 16 KiB bank window at 0x8000, 16 KiB RAM"
	select COSMAC_BANKING
	---help---
		Code banking (ADR 0013): the ROM image is a 32 KiB fixed part
		followed by CONFIG_COSMAC_BANK_COUNT banks of 16 KiB; the bank
		shown at 0x8000-0xBFFF is selected by a latch on output port
		CONFIG_COSMAC_BANK_PORT.  Objects are placed in banks by the rules
		in scripts/banks.txt.

config BOARD_SIM1802_PROFILE_SIM64
	bool "SIM64: ROM image from 0x0000, RAM for the rest of 64 KiB"
	---help---
		Development profile: the ROM is exactly as large as the image
		and everything above it is RAM.

endchoice # Memory profile

config SIM1802_UART0
	bool "Console as a serial device (UART0, /dev/ttyS0)"
	default n
	select UART0_SERIALDRIVER
	select SERIAL_IFLOWCONTROL
	---help---
		The simulator console through NuttX's serial driver: buffered,
		interrupt-driven input (IRQ 6) with flow control, and the
		/dev/console device when UART0 is the serial console.  Without it,
		the console is syslog output only (CONFIG_CONSOLE_SYSLOG).

config BOARD_SIM1802_CLOCK_HZ
	int "Nominal CPU clock (Hz)"
	default 4000000
	---help---
		The simulator has no clock; this value converts time into
		machine cycles (8 clock periods each) for the cycle-driven
		timer and into time for measurements.

config BOARD_SIM1802_TICKTEST
	bool "Timer tick and watchdog test (replaces the idle loop)"
	default n
	select ARCH_IDLE_CUSTOM
	---help---
		Test code for the port's Step 07: the idle loop starts a watchdog
		that re-arms itself every 50 ticks, prints the tick and machine
		cycle counts between callbacks and the cost of a timer interrupt,
		then halts the simulator.  Not for normal use.

config BOARD_SIM1802_THREADTEST
	bool "Thread, preemption and signal test (init task entry point)"
	default n
	depends on ENABLE_ALL_SIGNALS
	---help---
		Test code for the port's Step 08: set CONFIG_INIT_ENTRYPOINT to
		"sim1802_threadtest_main".  Round-robin preemption, semaphores,
		usleep(), signals to blocked and running tasks, the cost of a
		context switch, then the simulator halts.  Not for normal use.

endif # ARCH_BOARD_SIM1802
```
